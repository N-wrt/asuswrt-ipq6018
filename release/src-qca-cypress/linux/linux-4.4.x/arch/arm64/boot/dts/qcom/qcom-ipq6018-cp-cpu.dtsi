/*
 * Copyright (c) 2019, The Linux Foundation. All rights reserved.
 *
 * Permission to use, copy, modify, and/or distribute this software for any
 * purpose with or without fee is hereby granted, provided that the above
 * copyright notice and this permission notice appear in all copies.
 *
 * THE SOFTWARE IS PROVIDED "AS IS" AND THE AUTHOR DISCLAIMS ALL WARRANTIES
 * WITH REGARD TO THIS SOFTWARE INCLUDING ALL IMPLIED WARRANTIES OF
 * MERCHANTABILITY AND FITNESS. IN NO EVENT SHALL THE AUTHOR BE LIABLE FOR
 * ANY SPECIAL, DIRECT, INDIRECT, OR CONSEQUENTIAL DAMAGES OR ANY DAMAGES
 * WHATSOEVER RESULTING FROM LOSS OF USE, DATA OR PROFITS, WHETHER IN AN
 * ACTION OF CONTRACT, NEGLIGENCE OR OTHER TORTIOUS ACTION, ARISING OUT OF
 * OR IN CONNECTION WITH THE USE OR PERFORMANCE OF THIS SOFTWARE.
 */

&CPU0 {
	operating-points = <0xd2f00 0x10c8e0 0x101d00 0x10c8e0 0x124f80 0x10c8e0>;
	clock-latency = <0x30d40>;
};

&CPU1 {
	operating-points = <0xd2f00 0x10c8e0 0x101d00 0x10c8e0 0x124f80 0x10c8e0>;
	clock-latency = <0x30d40>;
};

&CPU2 {
	operating-points = <0xd2f00 0x10c8e0 0x101d00 0x10c8e0 0x124f80 0x10c8e0>;
	clock-latency = <0x30d40>;
};

&CPU3 {
	operating-points = <0xd2f00 0x10c8e0 0x101d00 0x10c8e0 0x124f80 0x10c8e0>;
	clock-latency = <0x30d40>;
};

